## arch/riscv32/soc/riscv-privilege/glacial/Kconfig.defconfig.series
```kconfig
if SOC_SERIES_RISCV32_GLACIAL

config SOC_SERIES
	string
	default "glacial"

config SYS_CLOCK_HW_CYCLES_PER_SEC
	int
	default 100000

config RISCV_SOC_INTERRUPT_INIT
	bool
	default n

config INCLUDE_RESET_VECTOR
	bool
	default n

config RISCV_HAS_CPU_IDLE
	bool
	default n

config RISCV_HAS_PLIC
	bool
	default n

config NUM_IRQS
	int
	default 32

config XIP
	bool
	default n

config RISCV_ROM_BASE_ADDR
	hex
	default 0x00000000

config RISCV_ROM_SIZE
	hex
	default 0x00008000

config RISCV_RAM_BASE_ADDR
	hex
	default 0x00007f00

config RISCV_RAM_SIZE
	hex
	default 0x8000

endif # SOC_SERIES_RISCV32_GLACIAL
```

## arch/riscv32/soc/riscv-privilege/glacial/Kconfig.series
```kconfig
# Kconfig - riscv32 QEMU SOC implementation
#
# Copyright (c) 2017 Jean-Paul Etienne <fractalclone@gmail.com>
#
# SPDX-License-Identifier: Apache-2.0
#

config SOC_SERIES_RISCV32_GLACIAL
	bool "Glacial implementation"
	depends on RISCV32
	select SOC_FAMILY_RISCV_PRIVILEGE
	help
	  Enable support for Glacial implementation
```

## arch/riscv32/soc/riscv-privilege/glacial/Kconfig.soc
```kconfig
# Kconfig - Glacial SOC configuration options
#
# Copyright (c) 2017 Jean-Paul Etienne <fractalclone@gmail.com>
#
# SPDX-License-Identifier: Apache-2.0
#

choice
prompt "Glacial implementation"
depends on SOC_SERIES_GLACIAL

config SOC_RISCV32_GLACIAL
	bool "Glacial SOC implementation"
	select ATOMIC_OPERATIONS_C

endchoice
```

## boards/riscv32/glacial/glacial_defconfig
```kconfig
CONFIG_RISCV32=y
CONFIG_SOC_SERIES_RISCV32_GLACIAL=y
CONFIG_SOC_RISCV32_GLACIAL=y
CONFIG_BOARD_GLACIAL=y
CONFIG_CONSOLE=y
CONFIG_SERIAL=y
CONFIG_UART_GLACIAL=y

CONFIG_UART_CONSOLE=y
CONFIG_UART_CONSOLE_ON_DEV_NAME="uart0"
CONFIG_PLIC=n
CONFIG_RISCV_MACHINE_TIMER=y
CONFIG_GPIO=n
CONFIG_XIP=n
CONFIG_BOOT_BANNER=y
```
